# PAC55XX register map
Vendor: Active-Semi; Series: PAC55XX; File version: 1.0
CPU: CM4 r0p1, little endian, MPU, FPU, vendor SysTick, 3 interrupt priority bits
Registers are 32-bit, read-write, reset 0x0 unless marked. A register's access mark holds for its fields unless they carry their own. Offsets are from the block's base; [hi:lo] are bit positions.

## GPTIMERA — General Purpose Timer A (GPTimer A)
Base 0x400B0000
0x00 CTL — GPTimer A Control
0x04 CTR — GPTimer A Counter

## GPTIMERB — General Purpose Timer B (GPTimer B)
Base 0x400C0000
0x00 CTL — GPTimer B Control
0x04 CTR — GPTimer B Counter

## MEMCTL — Memory Controller
Base 0x400D0000
0x00 MEMCTL — Memory Controller Configuration
0x04 MEMSTATUS — Memory Controller Status
0x08 FLASHLOCK — FLASH Lock Access
0x0C FLASHPAGE
0x10 SWDUNLOCK
0x20 FLASHERASE

## SCC — System and Clock Control
Base 0x400D0400
0x00 CCSCTL
0x04 CCSPLLCTL
0x08 CCSROSCTRIM
0x0C PAMUXSEL — PA Peripheral MUX Select
0x10 PBMUXSEL — PB Peripheral MUX Select
0x14 PCMUXSEL — PC Peripheral MUX Select
0x18 PDMUXSEL — PD Peripheral MUX Select
0x1C PEMUXSEL — PE Peripheral MUX Select
0x20 PFMUXSEL — PF Peripheral MUX Select
0x24 PGMUXSEL — PG Peripheral MUX Select
0x28 PAPUEN — PA Weak Pull-up Enable
0x2C PBPUEN — PB Weak Pull-up Enable
0x30 PCPUEN — PC Weak Pull-up Enable
0x34 PDPUEN — PD Weak Pull-up Enable
0x38 PEPUEN — PE Weak Pull-up Enable
0x3C PFPUEN — PF Weak Pull-up Enable
0x40 PGPUEN — PG Weak Pull-up Enable
0x44 PAPDEN — PA Weak Pull-down Enable
0x48 PBPDEN — PB Weak Pull-down Enable
0x4C PCPDEN — PC Weak Pull-down Enable
0x50 PDPDEN — PD Weak Pull-down Enable
0x54 PEPDEN — PE Weak Pull-down Enable
0x58 PFPDEN — PF Weak Pull-down Enable
0x5C PGPDEN — PG Weak Pull-down Enable
0x60 PADS — PA Drive Strength/Schmitt Trigger
0x64 PBDS — PB Drive Strength/Schmitt Trigger
0x68 PCDS — PC Drive Strength/Schmitt Trigger
0x6C PDDS — PD Drive Strength/Schmitt Trigger
0x70 PEDS — PE Drive Strength/Schmitt Trigger
0x74 PFDS — PF Drive Strength/Schmitt Trigger
0x78 PGDS — PG Drive Strength/Schmitt Trigger

## WWDT — Windowed Watchdog Timer
Base 0x400D0800
0x00 CTL — WWDT Control
0x04 LOAD — WWDT Load Counter Value
0x08 CTR — WWDT Counter
0x0C INTF — WWDT Interrupt Flag
0x10 INTCLR — WWDT Interrupt Clear
0x14 LOCK — WWDT Lock

## RTC — Real-Time Clock (RTC) with Calendar
Base 0x400D0C00
0x00 CTL — RTC Control
0x04 TIME — RTC Time
0x08 DATE — RTC Date
0x0C TIMESET — RTC Time Setting
0x10 DATESET — RTC Date Setting
0x14 ALARMSET — RTC Alarm Setting

## CRC
Base 0x400D1000
0x00 CTL — CRC Control
0x04 DATAIN — CRC Data Input
0x08 SEED — CRC Seed Value
0x0C DATAOUT — CRC Data Output

## GPIOA
Base 0x400D1400
0x00 MODE — GPIO A Pin Mode Select
0x04 OUTMASK — GPIO A Data Output Write Mask
0x08 OUT — GPIO A Data Output Value
0x0C IN — GPIO A Data Input Value
0x10 INTEN — GPIO A Interrupt Enable
0x14 INTFLAGRAW — GPIO A Interrupt Flag Raw
0x18 INTFLAGMASKED — GPIO A Interrupt Flag Masked
0x1C INTCLEAR — GPIO A Interrupt Clear
0x20 INTTYPE — GPIO A Interrupt Type
0x24 INTVALUE — GPIO A Interrupt Value
0x28 INTEDGEBOTH — GPIO A Interrupt Edge Both
0x2C DEBOUNCE — GPIO A De-bounce Filter
0x30 DOSET — GPIO A Data Output Set
0x34 DOCLEAR — GPIO A Data Output Clear

## GPIOB
Base 0x400D1800
0x00 MODE — GPIO B Pin Mode Select
0x04 OUTMASK — GPIO B Data Output Write Mask
0x08 OUT — GPIO B Data Output Value
0x0C IN — GPIO B Data Input Value
0x10 INTEN — GPIO B Interrupt Enable
0x14 INTFLAGRAW — GPIO B Interrupt Flag Raw
0x18 INTFLAGMASKED — GPIO B Interrupt Flag Masked
0x1C INTCLEAR — GPIO B Interrupt Clear
0x20 INTTYPE — GPIO B Interrupt Type
0x24 INTVALUE — GPIO B Interrupt Value
0x28 INTEDGEBOTH — GPIO B Interrupt Edge Both
0x2C DEBOUNCE — GPIO B De-bounce Filter
0x30 DOSET — GPIO B Data Output Set
0x34 DOCLEAR — GPIO B Data Output Clear

## GPIOC
Base 0x400D1C00
0x00 MODE — GPIO C Pin Mode Select
0x04 OUTMASK — GPIO C Data Output Write Mask
0x08 OUT — GPIO C Data Output Value
0x0C IN — GPIO C Data Input Value
0x10 INTEN — GPIO C Interrupt Enable
0x14 INTFLAGRAW — GPIO C Interrupt Flag Raw
0x18 INTFLAGMASKED — GPIO C Interrupt Flag Masked
0x1C INTCLEAR — GPIO C Interrupt Clear
0x20 INTTYPE — GPIO C Interrupt Type
0x24 INTVALUE — GPIO C Interrupt Value
0x28 INTEDGEBOTH — GPIO C Interrupt Edge Both
0x2C DEBOUNCE — GPIO C De-bounce Filter
0x30 DOSET — GPIO C Data Output Set
0x34 DOCLEAR — GPIO C Data Output Clear

## GPIOD
Base 0x400D2000
0x00 MODE — GPIO D Pin Mode Select
0x04 OUTMASK — GPIO D Data Output Write Mask
0x08 OUT — GPIO D Data Output Value
0x0C IN — GPIO D Data Input Value
0x10 INTEN — GPIO D Interrupt Enable
0x14 INTFLAGRAW — GPIO D Interrupt Flag Raw
0x18 INTFLAGMASKED — GPIO D Interrupt Flag Masked
0x1C INTCLEAR — GPIO D Interrupt Clear
0x20 INTTYPE — GPIO D Interrupt Type
0x24 INTVALUE — GPIO D Interrupt Value
0x28 INTEDGEBOTH — GPIO D Interrupt Edge Both
0x2C DEBOUNCE — GPIO D De-bounce Filter
0x30 DOSET — GPIO D Data Output Set
0x34 DOCLEAR — GPIO D Data Output Clear

## GPIOE
Base 0x400D2400
0x00 MODE — GPIO E Pin Mode Select
0x04 OUTMASK — GPIO E Data Output Write Mask
0x08 OUT — GPIO E Data Output Value
0x0C IN — GPIO E Data Input Value
0x10 INTEN — GPIO E Interrupt Enable
0x14 INTFLAGRAW — GPIO E Interrupt Flag Raw
0x18 INTFLAGMASKED — GPIO E Interrupt Flag Masked
0x1C INTCLEAR — GPIO E Interrupt Clear
0x20 INTTYPE — GPIO E Interrupt Type
0x24 INTVALUE — GPIO E Interrupt Value
0x28 INTEDGEBOTH — GPIO E Interrupt Edge Both
0x2C DEBOUNCE — GPIO E De-bounce Filter
0x30 DOSET — GPIO E Data Output Set
0x34 DOCLEAR — GPIO E Data Output Clear

## GPIOF
Base 0x400D2800
0x00 MODE — GPIO F Pin Mode Select
0x04 OUTMASK — GPIO F Data Output Write Mask
0x08 OUT — GPIO F Data Output Value
0x0C IN — GPIO F Data Input Value
0x10 INTEN — GPIO F Interrupt Enable
0x14 INTFLAGRAW — GPIO F Interrupt Flag Raw
0x18 INTFLAGMASKED — GPIO F Interrupt Flag Masked
0x1C INTCLEAR — GPIO F Interrupt Clear
0x20 INTTYPE — GPIO F Interrupt Type
0x24 INTVALUE — GPIO F Interrupt Value
0x28 INTEDGEBOTH — GPIO F Interrupt Edge Both
0x2C DEBOUNCE — GPIO F De-bounce Filter
0x30 DOSET — GPIO F Data Output Set
0x34 DOCLEAR — GPIO F Data Output Clear

## GPIOG
Base 0x400D2C00
0x00 MODE — GPIO G Pin Mode Select
0x04 OUTMASK — GPIO G Data Output Write Mask
0x08 OUT — GPIO G Data Output Value
0x0C IN — GPIO G Data Input Value
0x10 INTEN — GPIO G Interrupt Enable
0x14 INTFLAGRAW — GPIO G Interrupt Flag Raw
0x18 INTFLAGMASKED — GPIO G Interrupt Flag Masked
0x1C INTCLEAR — GPIO G Interrupt Clear
0x20 INTTYPE — GPIO G Interrupt Type
0x24 INTVALUE — GPIO G Interrupt Value
0x28 INTEDGEBOTH — GPIO G Interrupt Edge Both
0x2C DEBOUNCE — GPIO G De-bounce Filter
0x30 DOSET — GPIO G Data Output Set
0x34 DOCLEAR — GPIO G Data Output Clear
