# PAC55XX register map
Vendor: Active-Semi; Series: PAC55XX; File version: 1.0
ARM Cortex-M4 processor with FPU, running up to 150MHz with a set of analog and digital peripherals for power and motor control applications.
CPU: CM4 r0p1, little endian, MPU, FPU, vendor SysTick, 3 interrupt priority bits
Registers are 32-bit, read-write, reset 0x0 unless marked. A register's access mark holds for its fields unless they carry their own. Offsets are from the block's base; lines under a group give offsets from that group; [hi:lo] are bit positions; {n}, {i} and the like mark numbered series; 'fields as' and 'values as' point back to an identical list; <NAME> marks a mode.

## Memory map
0x40000000 ADC size 0x10000 — 2.5 MSPS, 12-bit SAR ADC
0x40010000 I2C size 0x10000
0x40020000 USARTA size 0x10000
0x40030000 USARTB size 0x10000
0x40040000 USARTC size 0x10000
0x40050000 USARTD size 0x10000
0x40060000 TimerA size 0x10000
0x40070000 TimerB size 0x10000
0x40080000 TimerC size 0x10000
0x40090000 TimerD size 0x10000
0x400A0000 CAN size 0x10000
0x400B0000 GPTIMERA size 0x10000 — General Purpose Timer A (GPTimer A)
0x400C0000 GPTIMERB size 0x10000 — General Purpose Timer B (GPTimer B)
0x400D0000 MEMCTL size 0x400 — Memory Controller
0x400D0400 SCC size 0x400 — System and Clock Control
0x400D0800 WWDT size 0x400 — Windowed Watchdog Timer
0x400D0C00 RTC size 0x400 — Real-Time Clock (RTC) with Calendar
0x400D1000 CRC size 0x400
0x400D1400 GPIOA size 0x400
0x400D1800 GPIOB size 0x400
0x400D1C00 GPIOC size 0x400
0x400D2000 GPIOD size 0x400
0x400D2400 GPIOE size 0x400
0x400D2800 GPIOF size 0x400
0x400D2C00 GPIOG size 0x400

## Interrupts
0 MEMCTL
1 WWDT
2 RTC
3 ADC0 (ADC)
4 ADC1 (ADC)
5 ADC2 (ADC)
6 ADC3 (ADC)
7 TIMERA (TimerA)
8 TIMERB (TimerB)
9 TIMERC (TimerC)
10 TIMERD (TimerD)
11 TIMERAQEP (TimerA)
12 TIMERBQEP (TimerB)
13 TIMERCQEP (TimerC)
14 TIMERDQEP (TimerD)
15 GPIOA
16 GPIOB
17 GPIOC
18 GPIOD
19 GPIOE
20 GPIOF
21 GPIOG
22 I2C
23 USARTA
24 USARTB
25 USARTC
26 USARTD
27 CAN
28 GPTIMERA
29 GPTIMERB
30 SCC

## ADC — 2.5 MSPS, 12-bit SAR ADC
Base 0x40000000
0x00 EMUXCTL — EMUX Control
0x04 EMUXDATA
0x08 ADCCTL — ADC Control
0x0C ADCRES — ADC Result
0x10 ADCINT — ADC Interrupt Control
0x40 DTSETRIGENT0TO3 — DTSE Trigger Entry 0 to 3
0x44 DTSETRIGENT4TO7 — DTSE Trigger Entry 4 to 7
0x48 DTSETRIGENT8TO11 — DTSE Trigger Entry 8 to 11
0x4C DTSETRIGENT12TO15 — DTSE Trigger Entry 12 to 15
0x50 DTSETRIGENT16TO19 — DTSE Trigger Entry 16 to 19
0x54 DTSETRIGENT20TO23 — DTSE Trigger Entry 20 to 23
0x58 DTSETRIGENT24TO27 — DTSE Trigger Entry 24 to 27
0x5C DTSETRIGENT28TO31 — DTSE Trigger Entry 28 to 31
{0x80+4i} DTSESEQCFG{i} (i=0..7) — DTSE Sequence Config {i}
{0xE0+4i} DTSESEQCFG{i} (i=8..23) — DTSE Sequence Config {i}
{0x200+4i} DTSERES{i} (i=0..23) — DTSE Result {i}

## I2C
Base 0x40010000
0x00 CONSET — I2C Control Set
0x04 CONCLR — I2C Control Clear
0x08 STAT — I2C Status
0x0C DAT — I2C Data
0x10 CLK — I2C Clock Control
0x14 ADR0 — I2C Slave Address 0
0x18 ADRM0 — I2C Slave Address Mask 0
0x1C XADR0 — I2C Extended Slave Address 0
0x20 XADRM0 — I2C Extended Slave Address Mask 0
0x24 RST — I2C Software Reset
{0x20+8i} ADR{i} (i=1..3) — I2C Slave Address {i}
{0x24+8i} ADRM{i} (i=1..3) — I2C Slave Address Mask {i}

## USARTA
Base 0x40020000
0x00 RBR_CON — UART A Receive Buffer / SSP A Control
0x04 THR_STAT — UART A Transmit Holding / SSP A Status
0x08 DRL_DAT — UART A Divisor Latch / SSP A Data
0x0C IER_CLK — UART A Interrupt Enable / SSP A Clock Control
0x10 IIR_IMSC — UART A Interrupt Identification / SSP A Interrupt Mask Set and Clear
0x14 FCR_RIS — UART A FIFO Control / SSP A Raw Interrupt Status
0x18 LCR_MIS — UART A Line Control / SSP A Masked Interrupt Status
0x1C ICLR — SSP A Interrupt Clear
0x20 LSR — UART A Line Status
0x28 SCR_SSCR — UART A Scratch Pad / SSP A Slave Select Configuration
0x2C EFR — Enhanced Feature

## Licence text in the file
THIS SOFTWARE IS SUBJECT TO A SOURCE CODE LICENSE AGREEMENT WHICH PROVIDES, AMONG OTHER THINGS: (i) THAT IT CAN BE USED ONLY TO ADAPT THE LICENSEE'S APPLICATION TO PAC PROCESSORS SUPPLIED BY ACTIVE-SEMI INTERNATIONAL; (ii) THAT IT IS PROVIDED "AS IS" WITHOUT WARRANTY; (iii) THAT ACTIVE-SEMICONDUCTOR IS NOT LIABLE FOR ANY INDIRECT DAMAGES OR FOR DIRECT DAMAGES EXCEEDING US$1,500; AND (iv) THAT IT CAN BE DISCLOSED TO AND USED ONLY BY CERTAIN AUTHORIZED PERSONS.

## Notices in the file
Copyright (C) 2017 Active-Semi, Inc. All rights reserved.
